## boards/shields/msp/Kconfig.defconfig
```kconfig
if SHIELD_MSP_LEFT

config ZMK_KEYBOARD_NAME
    default "my_split"

config ZMK_SPLIT_ROLE_CENTRAL
    default y

endif # SHIELD_MSP_LEFT

if SHIELD_MSP_LEFT || SHIELD_MSP_RIGHT

config ZMK_SPLIT
    default y

endif # SHIELD_MSP_LEFT || SHIELD_MSP_RIGHT
```

## boards/shields/msp/Kconfig.shield
```kconfig
config SHIELD_MSP_LEFT
    def_bool $(shields_list_contains,msp_left)

config SHIELD_MSP_RIGHT
    def_bool $(shields_list_contains,msp_right)
```

## build/msp_left/Kconfig/Kconfig.modules
```kconfig
menu "nanopb (/home/hazcoper/Documents/zmk-config/.zmk/modules/lib/nanopb)"
osource "$(ZEPHYR_NANOPB_KCONFIG)"
config ZEPHYR_NANOPB_MODULE
	bool
	default y
endmenu
menu "acpica (/home/hazcoper/Documents/zmk-config/.zmk/modules/lib/acpica)"
osource "$(ZEPHYR_ACPICA_KCONFIG)"
config ZEPHYR_ACPICA_MODULE
	bool
	default y
endmenu
menu "canopennode (/home/hazcoper/Documents/zmk-config/.zmk/modules/lib/canopennode)"
osource "$(ZEPHYR_CANOPENNODE_KCONFIG)"
config ZEPHYR_CANOPENNODE_MODULE
	bool
	default y
endmenu
menu "cmsis-dsp (/home/hazcoper/Documents/zmk-config/.zmk/modules/lib/cmsis-dsp)"
osource "$(ZEPHYR_CMSIS_DSP_KCONFIG)"
config ZEPHYR_CMSIS_DSP_MODULE
	bool
	default y
endmenu
menu "cmsis-nn (/home/hazcoper/Documents/zmk-config/.zmk/modules/lib/cmsis-nn)"
osource "$(ZEPHYR_CMSIS_NN_KCONFIG)"
config ZEPHYR_CMSIS_NN_MODULE
	bool
	default y
endmenu
menu "fatfs (/home/hazcoper/Documents/zmk-config/.zmk/modules/fs/fatfs)"
osource "$(ZEPHYR_FATFS_KCONFIG)"
config ZEPHYR_FATFS_MODULE
	bool
	default y
endmenu
menu "liblc3 (/home/hazcoper/Documents/zmk-config/.zmk/modules/lib/liblc3)"
osource "$(ZEPHYR_LIBLC3_KCONFIG)"
config ZEPHYR_LIBLC3_MODULE
	bool
	default y
endmenu
menu "littlefs (/home/hazcoper/Documents/zmk-config/.zmk/modules/fs/littlefs)"
osource "$(ZEPHYR_LITTLEFS_KCONFIG)"
config ZEPHYR_LITTLEFS_MODULE
	bool
	default y
endmenu
menu "lvgl (/home/hazcoper/Documents/zmk-config/.zmk/modules/lib/gui/lvgl)"
osource "/home/hazcoper/Documents/zmk-config/.zmk/modules/lib/gui/lvgl/Kconfig"
config ZEPHYR_LVGL_MODULE
	bool
	default y
endmenu
menu "mbedtls (/home/hazcoper/Documents/zmk-config/.zmk/modules/crypto/mbedtls)"
osource "$(ZEPHYR_MBEDTLS_KCONFIG)"
config ZEPHYR_MBEDTLS_MODULE
	bool
	default y
endmenu
menu "percepio (/home/hazcoper/Documents/zmk-config/.zmk/modules/debug/percepio)"
osource "/home/hazcoper/Documents/zmk-config/.zmk/modules/debug/percepio/zephyr/Kconfig"
config ZEPHYR_PERCEPIO_MODULE
	bool
	default y
endmenu
menu "picolibc (/home/hazcoper/Documents/zmk-config/.zmk/modules/lib/picolibc)"
osource "/home/hazcoper/Documents/zmk-config/.zmk/modules/lib/picolibc/zephyr/Kconfig"
config ZEPHYR_PICOLIBC_MODULE
	bool
	default y
endmenu
menu "segger (/home/hazcoper/Documents/zmk-config/.zmk/modules/debug/segger)"
osource "$(ZEPHYR_SEGGER_KCONFIG)"
config ZEPHYR_SEGGER_MODULE
	bool
	default y
endmenu
menu "trusted-firmware-a (/home/hazcoper/Documents/zmk-config/.zmk/modules/tee/tf-a/trusted-firmware-a)"
osource "$(ZEPHYR_TRUSTED_FIRMWARE_A_KCONFIG)"
config ZEPHYR_TRUSTED_FIRMWARE_A_MODULE
	bool
	default y
endmenu
menu "uoscore-uedhoc (/home/hazcoper/Documents/zmk-config/.zmk/modules/lib/uoscore-uedhoc)"
osource "$(ZEPHYR_UOSCORE_UEDHOC_KCONFIG)"
config ZEPHYR_UOSCORE_UEDHOC_MODULE
	bool
	default y
endmenu
menu "zcbor (/home/hazcoper/Documents/zmk-config/.zmk/modules/lib/zcbor)"
osource "$(ZEPHYR_ZCBOR_KCONFIG)"
config ZEPHYR_ZCBOR_MODULE
	bool
	default y
endmenu
menu "module (/home/hazcoper/Documents/zmk-config/.zmk/zmk/app/module)"
osource "/home/hazcoper/Documents/zmk-config/.zmk/zmk/app/module/Kconfig"
config ZEPHYR_MODULE_MODULE
	bool
	default y
endmenu
```
